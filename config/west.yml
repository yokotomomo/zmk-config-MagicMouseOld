## config/west.yml
```yaml
manifest:
  remotes:
    - name: zmkfirmware
      url-base: https://github.com/petejohanson
    - name: caksoylar
      url-base: https://github.com/caksoylar
    - name: inorichi
      url-base: https://github.com/inorichi
  projects:
    - name: zmk
      remote: zmkfirmware
      revision: feat/pointers-move-scroll   # ← 2023年12月14日版（今回確定したもの）
      import: app/west.yml
    - name: zmk-rgbled-widget
      remote: caksoylar
      revision: 841ee9c                    # ← 2023年11月26日のコミットに固定
    - name: zmk-pmw3610-driver
      remote: inorichi
      revision: e56c706                    # ← 2023年11月23日のコミットに固定
  self:
    path: config
```
